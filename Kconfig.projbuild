## Kconfig.projbuild
```kconfig
menu "Websocket Component Configuration"

config Websocket Endpoint
    string "websocket endpoint adress"
	default ws://localhost:8080/someServer/someThing
	help
		enter the address of the websocket server that you want
		to connect to

endmenu
```
